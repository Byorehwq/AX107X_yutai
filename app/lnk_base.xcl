////////////////////////////////////////////////////////////////////////////////
//
//           This is a XLINK command file.
//
//   XLINK file for AX2070
//
//
////////////////////////////////////////////////////////////////////////////////
//phoenix memory map:
//Code: MROM1(0x2000-0x3FFF,8K),MROM2(0x2000-0x3FFF,8K),MROM0(0x8000-0xFFFF,32K)
//RAM:  IRAM(0x0000-0x1400,5K),DECRAM(0x4000-0x55FF,5K)


///////////////////////////////////////////////////////////////////////////////////////////////////
//    IDATA
-D_IDATA_START=0x6D
-D_IDATA_END=0x94              // Last address of Idata memory (0xFF for 8052 and 0x7F for 8051)
//
//    PDATA
-D_PDATA_START=0xB2          // First address for PDATA memory.
-D_PDATA_END=0xFF            // Last address for PDATA memory.
//
//    IXDATA
-D_IXDATA_START=0x0500              // First address of on chip XDATA memory.
-D_IXDATA_END=0x7FF             // Last address of on chip XDATA memory.
//
//    XDATA
-D_XDATA_START=_IXDATA_START        // First address of xdata memory.
-D_XDATA_END=_IXDATA_END          // Last address of xdata memory.
//
//    CODE
//
-D_OTP_CODE_START=0x4000    // First address for code.
-D_OTP_CODE_END=0x7FEF      // Last address for code.
//
//    NEAR CODE
//
-D_NEAR_CODE_END=0x7FFF        // Last address for near code.

//    Register bank setup
//
-D?REGISTER_BANK=0             // Default register bank (0,1,2,3).
-D_REGISTER_BANK_START=0       // Start address for default register bank (00,08,10,18).
//
//    Virtual register setup
//    ----------------------
//
-D_BREG_START=0x00             // The bit address where the BREG segments starts.
-D_BREG_END=0x07
                               // Must be placed on: _BREG_START%8=0 where _BREG_START <= 0x78.
-D?VB=0x20                     // ?VB is used when referencing BREG as whole byte.
                               // Must be placed on: ?VB=0x20+_BREG_START/8
//    PDATA page setup
//
-D?PBANK_NUMBER=0	       // high byte of 16-bit address to the PDATA area
-D?PBANK=0xBF                    // Most significant byte in MOVX A,@R0. (0xA0 is sfr P2)
//-D?PBANK_EXT=0xEA              // Most significant byte in MOVX A,@R0. (0xEA is for Dallas DS80C390)

-D?ESP=9B

///////////////////////////////////////////////////////////////////////////////////////////////////////////////
//
// IDATA memory
//

// Setup "bit" segments (only for '__no_init bool' variables).
-Z(BIT)BREG=_BREG_START-_BREG_END
-Z(BIT)BIT_N=30-FF
-Z(DATA)BDATA_N=0x26-0x2F
-Z(DATA)SYS_BDATA=0x26-0x2F

-Z(DATA)REGISTERS+8=_REGISTER_BANK_START
-Z(DATA)VREG+_NR_OF_VIRTUAL_REGISTERS=30-7F
-Z(DATA)PSP,XSP=40-7F
-Z(DATA)DOVERLAY=40-7F
-Z(DATA)DATA_I,DATA_Z,DATA_N=47-4F,6D-7F

-Z(DATA)SYS_DATA=44-46          //maskrom����
-Z(DATA)DECODER_DATA=50-5B      //maskrom����
-Z(DATA)MP3_DATA=5C-6C          //maskrom����

//����MP3_DATA
-Z(DATA)WAV_DATA=15E-160        //maskrom����
-Z(DATA)USBDEV_DATA=25C-26C     //maskrom����
-Z(DATA)BT_DATA=35C-36C

-U(IDATA)20-7F=(DATA)20-7F
-Z(IDATA)IDATA_I,IDATA_Z,IDATA_N=_IDATA_START-_IDATA_END
-Z(IDATA)ISTACK+_IDATA_STACK_SIZE#20-_IDATA_END
-Z(IDATA)IOVERLAY=20-FF

////////////////////////////////////////////////////////////////////////////////
//
// ROM memory
//

// Note: INTVEC must be placed first.
// Note: CSTART Must be located in first 64k.

//
// Program memory
//
-Z(CODE)INTVEC=4000
-Z(CODE)OTP_RESET,OTP_VECTOR=0x4080
-Z(CODE)DAC_ASM=_OTP_CODE_START-_OTP_CODE_END
-Z(CODE)KEY_VOICE_TBL=_OTP_CODE_START-_OTP_CODE_END
-Z(CODE)CSTART,CLK_SEG,I2C_CB_SEG,AMUX_SEG,AUADC_SEG,NEAR_CODE,CODE_C,CODE_N=_OTP_CODE_START-_OTP_CODE_END

//*******************************************************************
//   COMMON CODE AREA: 0x4000-0x7FFF
//*******************************************************************
-Z(CODE)BIT_ID,BDATA_ID,DATA_ID,IDATA_ID,IXDATA_ID,PDATA_ID,XDATA_ID=_OTP_CODE_START-_OTP_CODE_END
-Z(CODE)RCODE,USB_FIX,USB_FIX_ASM=_OTP_CODE_START-_OTP_CODE_END

//SYSTEM
-Z(CODE)SYS_DELAY,SYS_INIT,INTERRUPT,SET_SYS_CLK_SEG=_OTP_CODE_START-_OTP_CODE_END
-Z(CODE)DAC_INIT,DAC_INIT_CONST,DAC_SEG=_OTP_CODE_START-_OTP_CODE_END

//MUSIC
-Z(CODE)MUSIC_SEG=_OTP_CODE_START-_OTP_CODE_END
-Z(CODE)USER_MUSIC_SEG=_OTP_CODE_START-_OTP_CODE_END

//AMUX
-Z(CODE)USER_AMUX_CONST,USER_AMUX_SEG=_OTP_CODE_START-_OTP_CODE_END

//FM
-Z(CODE)API_FM,FM_FADE=_OTP_CODE_START-_OTP_CODE_END
-Z(CODE)RDA5807_RX,RDA5807_RX_TABLE,QN8035_RX_EXT,QN8035_RX,QN8065_RX,QN8065_RX_TABLE,BK1080,BK1080_RX_TABLE=_OTP_CODE_START-_OTP_CODE_END
-Z(CODE)AR1010_RX,AR1010_RX_TABLE,AR1019_RX,SP3777_RX,SP3777_RX_TABLE,KT0830EG=_OTP_CODE_START-_OTP_CODE_END
-Z(CODE)CL6017S_RX,CL6017S_RX_TABLE,CL6017G_RX,CL6017G_RX_TABLE,RTC6218_RX,RTC6218_RX_TABLE=_OTP_CODE_START-_OTP_CODE_END

//RTC
-Z(CODE)RTC_TBL,RTC_INIT,RTC_SEG_API=_OTP_CODE_START-_OTP_CODE_END

//KEY & IR & KEDIR & TOUCHKEY
-Z(CODE)KEY_INIT,SCAN_COM,KEY_CONST_TABLE=_OTP_CODE_START-_OTP_CODE_END
-Z(CODE)IR_INIT,IR_SCAN,IR_CONST_TABLE=_OTP_CODE_START-_OTP_CODE_END
-Z(CODE)KEDIR_CODE,KEDIR_CONST_TABLE=_OTP_CODE_START-_OTP_CODE_END
-Z(CODE)TOUCH_KEY_SEG,TOUCH_KEY_TABLE=_OTP_CODE_START-_OTP_CODE_END

//DISPLAY
-Z(CODE)LCD_SEG_TBL,LCD_INIT,LCD_SEG_API=_OTP_CODE_START-_OTP_CODE_END
-Z(CODE)LED_5C7S_INIT,LED_5C7S_SEG=_OTP_CODE_START-_OTP_CODE_END
-Z(CODE)LED_SEG=_OTP_CODE_START-_OTP_CODE_END
-Z(CODE)LED_7P7S_INIT,LED_7P7S_SEG=_OTP_CODE_START-_OTP_CODE_END
-Z(CODE)LED_DISP_TBL,LED_DISP_SEG=_OTP_CODE_START-_OTP_CODE_END

//DEVICE
-Z(CODE)DEVICE_INIT,DEVICE_COM_SEG,DEVICE_SEG,DEV_ASM=_OTP_CODE_START-_OTP_CODE_END
-Z(CODE)SD_SEG,USB_SEG=_OTP_CODE_START-_OTP_CODE_END
-Z(CODE)USBDEV_TBL=_OTP_CODE_START-_OTP_CODE_END

//FAT
-Z(CODE)FAT_COM_SEG,FAT_SEG,FS_INIT_SEG,FAT_API_SEG=_OTP_CODE_START-_OTP_CODE_END
-Z(CODE)FS_SCAN_SEG,FILE_FILTER_SEG,FILE_FILTER_CONST=_OTP_CODE_START-_OTP_CODE_END

//OTHER
-Z(CODE)KEY_VOICE,EQ_TBL=_OTP_CODE_START-_OTP_CODE_END

//SPI FLASH
-Z(CODE)SPI_SEG,SPI_API_SEG,USER_SPI_SEG=_OTP_CODE_START-_OTP_CODE_END

//TASK
-Z(CODE)TASK_SEG,TASK_MUSIC_SEG,TASK_AUX_SEG,TASK_SPEAKER_SEG,TASK_SPEAKER_CONST=_OTP_CODE_START-_OTP_CODE_END
-Z(CODE)TASK_FM_SEG,TASK_RTC_SEG,TASK_USBDEV_SEG,TASK_ALARM_SEG,TASK_ALARM_CONST=_OTP_CODE_START-_OTP_CODE_END
-Z(CODE)TASK_IDLE_SEG,TASK_POWEROFF_SEG,TASK_LOWPOWER_SEG=_OTP_CODE_START-_OTP_CODE_END
-Z(CODE)TASK_FMAM_DETECT_SEG=_OTP_CODE_START-_OTP_CODE_END
-Z(CODE)TASK_FLASH_SEG,TASK_FLASH_CONST=_OTP_CODE_START-_OTP_CODE_END

//DISP
-Z(CODE)DISP_OCX_SEG=_OTP_CODE_START-_OTP_CODE_END
-Z(CODE)DISP_MUSIC_SEG=_OTP_CODE_START-_OTP_CODE_END
-Z(CODE)DISP_AUX_SEG=_OTP_CODE_START-_OTP_CODE_END
-Z(CODE)DISP_SPEAKER_SEG=_OTP_CODE_START-_OTP_CODE_END
-Z(CODE)DISP_FM_SEG=_OTP_CODE_START-_OTP_CODE_END
-Z(CODE)DISP_RTC_SEG=_OTP_CODE_START-_OTP_CODE_END
-Z(CODE)DISP_USBDEV_SEG=_OTP_CODE_START-_OTP_CODE_END
-Z(CODE)DISP_ALARM_SEG=_OTP_CODE_START-_OTP_CODE_END
-Z(CODE)DISP_POWEROFF_SEG=_OTP_CODE_START-_OTP_CODE_END
-Z(CODE)DISP_IDLE_SEG=_OTP_CODE_START-_OTP_CODE_END

//MEM
-Z(CODE)MEM,MEMEEP,MEMRTCRAM,MEMDEVICE,MEMINT=_OTP_CODE_START-_OTP_CODE_END

//USER
-Z(CODE)USER_SETTING_SEG,USER_SETTING_CONST,USER_IO_SEG,BAT_CHECK=_OTP_CODE_START-_OTP_CODE_END

//STARTMUSIC
-Z(CODE)STARTMUSIC_SEG,STARTMUSIC_CONST=_OTP_CODE_START-_OTP_CODE_END

//WKUP
-Z(CODE)WKUP_SEG=_OTP_CODE_START-_OTP_CODE_END

-Z(CODE)CODE_TBL=0x7ff0-0x7ff7
-Z(CODE)CHECKSUM#_OTP_CODE_END

-Z(CODE)M_CONSTANT=0xC00000-0xC0FFFF

////////////////////////////////////////////////////////////////////////////////
//
// XDATA memory
//

//
// Stacks located in XDATA
//
//-Z(XDATA)EXT_STACK=0x7000
-Z(XDATA)EXT_STACK+_EXTENDED_STACK_SIZE=_EXTENDED_STACK_START-_EXTENDED_STACK_END
-Z(XDATA)PSTACK+_PDATA_STACK_SIZE=_PDATA_START-_PDATA_END
-Z(XDATA)XSTACK+_XDATA_STACK_SIZE=_XDATA_START-_XDATA_END

//
// PDATA - data memory
//
-Z(XDATA)PDATA_N,PDATA_Z,PDATA_I=_PDATA_START-_PDATA_END
-Z(XDATA)MSG_POOL=_PDATA_START-_PDATA_END
-Z(XDATA)USB_HOST_MASS_PDATA,USB_HOST_PDATA=0x0D-0x36   //maskrom����
-Z(XDATA)FAT_PDATA=0x3F-0xA4                            //maskrom����

//
// XDATA - data memory
//
-Z(XDATA)IXDATA_N,IXDATA_Z,IXDATA_I=0x280-0x39C,_IXDATA_START-_IXDATA_END
-Z(XDATA)XDATA_N,XDATA_Z,XDATA_I=0x280-0x39C,_XDATA_START-_XDATA_END
-Z(XDATA)FILE_POINT_BUF,TRIM_XDATA=_XDATA_START-_XDATA_END
-Z(XDATA)XDATA_HEAP+_XDATA_HEAP_SIZE=_XDATA_START-_XDATA_END
-Z(CONST)XDATA_ROM_C=_XDATA_START-_XDATA_END

-Z(XDATA)DAC_XDATA=0x3CB-0x3D1          //maskrom����
-Z(XDATA)FAT_XDATA=0x468-0x48E          //maskrom����
-Z(XDATA)DECODER_BUF=0x7D0-0xFFF

//����MP3_L3_XDATA
-Z(XDATA)WAV_XDATA=0x20413-0x20416      //maskrom����
-Z(XDATA)ECHO_XDATA=0x2041B-0x20422     //maskrom����

//����DECODER_BUF
-Z(XDATA)DIR_PATH_XDATA=0x107D0
-Z(XDATA)BT_BUFF_1=0x207D0
-Z(XDATA)RTC6218_BUF,BK1080_BUF=0x307D0

//����DECRAM
-Z(XDATA)BT_XDATA=0x14500
-Z(XDATA)BT_BUFF_2=0x14560
-Z(XDATA)BT_SDBUFF=0x24680


-cx51
//printf
-R



